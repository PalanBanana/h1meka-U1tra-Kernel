// SPDX-License-Identifier: GPL-2.0-only OR BSD-2-Clause

/*
 * Minimal PM6150 PMIC definition for SM7150.
 *
 * Only the USID 0 PMIC parent node is described here. PMIC child
 * peripherals are intentionally not defined yet.
 */

#include <dt-bindings/spmi/spmi.h>

&spmi_bus {
	pmic@0 {
		compatible = "qcom,pm6150", "qcom,spmi-pmic";
		reg = <0x0 SPMI_USID>;
		#address-cells = <1>;
		#size-cells = <0>;
	};
};
